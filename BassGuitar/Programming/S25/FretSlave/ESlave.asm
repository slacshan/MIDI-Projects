;***************************************************************************
;
;	    Filename: Eslave.ASM
;	    Date: 11/05/2024
;	    File Version: 1
;	    Author: Owen Fujii
;	    Co-Author: Justin Bell
;	    Company: Idaho State University
;	    Description: A Program for a slave I2C device that plays notes on the
;			    E string of a Bass guitar
;**************************************************************************
	
;*************************************************************************
; 
;	    Revision History:
;   
;	    Modified as listed
;	    Started 11/05/2024
;
;*************************************************************************
    
; PIC16F1788 Configuration Bit Settings

; Assembly source line config statements

	#include "p16f1789.inc"
	#INCLUDE <ESlaveSetup.inc>
	#INCLUDE <ESlavePOPout.inc>
	#INCLUDE <ESlavePUSHin.inc>
	#INCLUDE <Hex_to_One.inc>

; CONFIG1
; __config 0xE9A4
 __CONFIG _CONFIG1, _FOSC_INTOSC & _WDTE_OFF & _PWRTE_OFF & _MCLRE_OFF & _CP_OFF & _CPD_OFF & _BOREN_OFF & _CLKOUTEN_ON & _IESO_OFF & _FCMEN_ON
; CONFIG2
; __config 0xDFFF
 __CONFIG _CONFIG2, _WRT_OFF & _VCAPEN_OFF & _PLLEN_ON & _STVREN_ON & _BORV_LO & _LPBOR_OFF & _LVP_OFF

    ORG H'000'					
    GOTO SETUP		    ;RESET CONDITION GOTO SETUP
    ORG H'004'
    GOTO INTER
    
SETUP
    BANKSEL OSCCON
    MOVLW H'07B'		    ; SET 16MHZ INTERNAL OSSCILATOR
    MOVWF OSCCON
    BANKSEL OSCSTAT
    BTFSC OSCSTAT,OSTS	    ; WAIT FOR OSSCILATOR TO BE READY
    GOTO $-1
    CALL START		    ; CALL SETUP INCLUDE
    ; ENABLE INTERRUPTS
    BANKSEL PIE1
    BSF PIE1,SSP1IE
    BSF INTCON,GIE	    ; ENABLE INTERRUPTS
    BSF INTCON,PEIE
    BANKSEL PORTE
    BSF PORTE,1		    ; SET STATUS FLAG
    GOTO MAIN

MAIN
    NOP
    BANKSEL PORTB
    ; HEX TO ONE CONVERTER TEST CODE UNCOMMENT THIS AND SUB TO TEST
;    GOTO ROTATING_TEST
;    CLRF TEMP
    ;
    BTFSS BUFFER,1	; WAIT FOR DATA BUFFER FLAG TO BE SET
    GOTO MAIN
    BSF PORTE,RE2		; SET ACTIVE FLAG
;   
    BTFSC PITCH,7	    ; CLEAR IF MUTE BIT IS LOW
    GOTO PLAY_NOTE
    CALL CLEAR
    GOTO JUMP
PLAY_NOTE
    BCF PITCH,7
    CALL DECSTRING
    BANKSEL PORTE
JUMP
    BCF PORTE,RE2		; CLEAR ACTIVE FLAG
    CLRF BUFFER			; CLEAR BUFFER FLAGS
    CLRF PITCH
    CLRF STRSEL
    GOTO MAIN
    
;ROTATING_TEST		; SUB ROUTINE THAT ADDS UP TO 0X08 IN HEX AND SETS 
;    BANKSEL PORTB	; THE OUTPUT TO PORTB. VERIFIES Hex to One Converter
;    MOVLW H'001'	; All LED OUTPUTS ON PORTB SHOULD BE LIT IF FUNCTIONAL
;    ADDWF TEMP,1
;    CALL Hex_To_One
;    MOVWF PORTB
;    NOP
;    NOP
;    NOP
;    NOP
;    NOP
;    NOP
;    NOP
;    NOP
;    BTFSC PORTB,7
;    GOTO MAIN
;    CLRF PORTB
;    GOTO ROTATING_TEST
    
;   BEGIN EVAL OF STRING BY ACCOUNTING OF OFFSETS
DECSTRING
    BANKSEL PORTA
    BTFSC STRSEL,0
    GOTO FRETSELECT		    ; NOTE EVALUATION IS ON THE E STRING
    BTFSC STRSEL,1
    GOTO A_OFFSET		    ; NOTE EVALUATION IS ON THE A STRING
    BTFSC STRSEL,2
    GOTO D_OFFSET		    ; NOTE EVALUATION IS ON THE D STRING
    BTFSC STRSEL,3
    GOTO G_OFFSET		    ; NOTE EVALUATION IS ON THE G STRING
    CALL CLEAR		    ; FAULT IN RECIEVED PITCH IF IT REACHES THIS POINT
    RETURN			    ; CLEAR DEVICE STATE IF THIS OCCURS
    
A_OFFSET
    MOVLW H'005'
    SUBWF PITCH,1   ; SUBTRACT THE 5 NOTE OFFSET FOR A STRING
    GOTO FRETSELECT

D_OFFSET
    MOVLW H'00A'    
    SUBWF PITCH,1   ; SUBTRACT THE 10 NOTE OFFSET FOR D STRING
    GOTO FRETSELECT
    
G_OFFSET
    MOVLW H'00F'
    SUBWF PITCH,1   ; SUBTRACT THE 15 NOTE OFFSET FOR G STRING
    GOTO FRETSELECT
    
FRETSELECT	; START READING HERE!!!!!!!!!
    MOVFW PITCH
    BCF STATUS,C
    SUBLW H'024'    ; THE MIDI NOTE LIMIT OF PORTB
    BTFSC STATUS,C
    GOTO PORT_B_SET	
    MOVFW PITCH		
    BCF STATUS,C
    SUBLW H'02A'
    BTFSC STATUS,C
    GOTO PORT_A_SET
    GOTO PORT_D_SET
    RETURN		; RETURN IF NO CASES FOUND OR BAD SKIP
    
PORT_B_SET
    BANKSEL PORTA	
    MOVFW PITCH
    SUBLW H'01C'	; REDUCE MIDI BY OFFSET TO GET 0X00 TO 0X08 STORE W
    MOVWF TEMP		; RESULT IS INVERSE 
    COMF TEMP		; COMPLEMENT RESULT TO GET CORRECT VALUE
    CALL Hex_To_One
    MOVWF PORTB		; MOVE RETURNED LITERAL TO PORTB
    RETURN	    
    
PORT_A_SET
    BANKSEL PORTA
    MOVFW PITCH
    SUBLW H'024'	; REDUCE MIDI TO GET 0X00 TO 0X05
    MOVWF TEMP
    COMF TEMP
    CALL Hex_To_One
    MOVWF PORTA		
    RETURN

PORT_D_SET
    BANKSEL PORTD
    MOVFW PITCH
    SUBLW H'02A'	; REDUCE MIDI TO GET 0X00 TO 0X05
    MOVWF TEMP
    COMF TEMP
    CALL Hex_To_One
    MOVWF PORTD
    RETURN
    
CLEAR
    BANKSEL PORTA
    CLRF PORTA	;CLEAR OUTPUTS FOR ENTIRE STRING AND GPRS
    CLRF PORTD
    CLRF PORTB
    RETURN
    
STOP
    BANKSEL SSP1CON1
    BCF SSP1CON1,SSPEN
    NOP
    NOP
    BSF SSP1CON1,SSPEN
    RETURN

    
INTER
    BANKSEL INTCON
    CLRF INTCON		    ; CLEAR INTERRUPTS
    CALL PUSHIN		    ; SAFE STATUS
    BANKSEL PIR1
    BTFSC PIR1,SSP1IF		    ; CHECK MSSP INTERRUPT FLAG
    CALL RECIEVE	
    BANKSEL SSP1STAT
    BTFSC SSP1STAT,P		    ; CHECK FOR STOP CONDITION
    CALL STOP
    BANKSEL INTCON
    BSF INTCON,GIE		    ; RE-ENABLE INTERRUPTS
    BSF INTCON,PEIE
    CALL POPOUT		    ; RETURN STATUS'S
    RETFIE
    
RECIEVE
    BANKSEL SSP1CON1	
    BSF SSP1CON1,CKP	; HOLD CLOCK LINE
    BANKSEL PORTD
    BCF PIR1,SSP1IF
    BANKSEL SSP1BUF 
    MOVFW SSP1BUF		    ; READ RECIEVED DATA
    BANKSEL PORTB
    MOVWF TEMP
    BANKSEL SSP1STAT
    BTFSS SSP1STAT,5
    GOTO ADDRETURN
    BANKSEL PORTB
    BTFSC BUFFER,0
    GOTO STRINGSEL
    BANKSEL PORTB
    MOVFW TEMP
    MOVWF PITCH
    BSF BUFFER,0	; SET VELOCITY BYTE RECIEVE FLAG
    BANKSEL SSP1CON1	
    BSF SSP1CON1,CKP		    ; RELEASE CLOCK LINE
    RETURN
    

ADDRETURN
    BANKSEL SSP1CON1	
    BSF SSP1CON1,CKP		    ; RELEASE CLOCK LINE
    RETURN
    

STRINGSEL
    BANKSEL PORTB
    MOVFW TEMP
    MOVWF STRSEL
    BSF BUFFER,1		    ; SET STRING RECIEVE FLAG
    BANKSEL SSP1CON1	
    BSF SSP1CON1,CKP		    ; RELEASE CLOCK LINE
    RETURN
END
