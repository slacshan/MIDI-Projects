;***************************************************************************
;
;	    Filename: Setup.inc
;	    Date: 04/22/205
;	    File Version: 1
;	    Author: Owen Fujii
;	    Co-Author: Justin Bell
;	    Company: Idaho State University
;	    Description: A collection of registry setups and subroutines
;
;*************************************************************************
	
;*************************************************************************
; 
;	    Revision History:
;   1: Inc file to contain generic registry setups 
;
;	2: Removed GPR setup and added code reference 
;	    Modified as listed
;	    Started 09/24/2024 -Current version implemented 10/7/2024
;	3: Defined constants and other setup feature in this custom
;	   setup file
;
;*************************************************************************
	
	
START_CODE CODE

START

;*********************
 ;Define Constants
 ;*********************
		PITCH	    EQU H'022'
		BUFFER	    EQU H'041'
		TEMP	    EQU H'042'
		STRSEL	    EQU H'044'
; SET STORAGE REGISTERS FOR EACH NOTE AND ITS MIDI VALUES
		E1MIDI	    EQU H'023'
		F1MIDI	    EQU H'024'
		FS1MIDI	    EQU H'025'
		G1MIDI	    EQU H'026'
		GS1MIDI	    EQU H'027'
		A1MIDI	    EQU H'028'
		AS1MIDI	    EQU H'029'
		B1MIDI	    EQU H'030'
		C2MIDI	    EQU H'031'
		CS2MIDI	    EQU H'032'
		D2MIDI	    EQU H'033'
		DS2MIDI	    EQU H'034'
		E2MIDI	    EQU H'035'
		F2MIDI	    EQU H'036'
		FS2MIDI	    EQU H'037'
		G2MIDI	    EQU H'038'
		GS2MIDI	    EQU H'039'
		A2MIDI	    EQU H'040'
		AS2MIDI	    EQU H'041'
		B2MIDI	    EQU H'042'
		C3MIDI	    EQU H'043'
;*** SET OPTION_REG: ****
		BANKSEL OPTION_REG
		MOVLW H'F4'                             ; INITIALIZE SET OF RBPU INTEDG T0SE 
		MOVWF OPTION_REG
;*** SET INTCON REG: ****
		BANKSEL INTCON
		MOVLW H'00'
		MOVWF INTCON   				; INIT PEIE
;*** SET PIE1 REG: *****
		BANKSEL PIE1
		MOVLW H'00'				; INIT PIE1 CLEAR
		MOVWF PIE1
;***** SET PIE2 REG: *****
		BANKSEL PIE2
		MOVLW H'00'				; INIT OSFIE CLEAR OTHERS
		MOVWF PIE2
;*** SET CCP1CON REG: **
		BANKSEL CCP1CON
		MOVLW	H'000'				;DISABLE PWM & CCP
		MOVWF	CCP1CON
		BANKSEL CCP2CON
		CLRF CCP2CON
		BANKSEL CM2CON1
		MOVLW   H'000'
		MOVWF   CM2CON1

;*** TIMER 1 SETUP *****
		BANKSEL T1CON
		MOVLW	H'000'				;
		MOVWF	T1CON				;DISABLE TIMER 1

;*** TIMER 2 SETUP *****

		BANKSEL T2CON
		CLRF	T2CON				;DISABLE TIMER 2, 1:1 POST SCALE, PRESCALER 1
		MOVLW	H'000'				;SET PR2 FOR FULL COUNT 
		BANKSEL	PR2				;
		MOVWF	PR2				;PR2 IS SETS OUTPUT OF PWM HIGH WHEN = TMR2
 
;*** PORT A SETUP **** PORT B RB0 IS USED AS EDGE TRIGGERED INPUT

		BANKSEL	ADCON1
		BCF	ADCON1,7
		BSF	ADCON1,5
		BSF	ADCON1,6
		BANKSEL PORTA
		CLRF    PORTA                           ; CLEAR PORTA
		BANKSEL ANSELA
		MOVLW H'000'
		MOVWF ANSELA
		BANKSEL	TRISA
		MOVLW	H'000'				;SET PORT A OUTPUT
		MOVWF	TRISA
		
;*** PORT B SETUP **** PORT B RB0 IS USED AS EDGE TRIGGERED INPUT
		BANKSEL PORTB
		CLRF    PORTB				; CLEAR PORTB 
		BANKSEL	TRISB
		MOVLW	H'000'				;SET PORT B AS OUTPUT
		MOVWF	TRISB
		BANKSEL ANSELB
		MOVLW H'000'                            ; DISABLE ADC INPUTS BANK B
		MOVWF ANSELB				
		BANKSEL WPUB				; DISABLE ALL WEAK PULL UPS PORT B
		MOVLW   H'000'
		MOVWF   WPUB
		BANKSEL ODCONB
		CLRF ODCONB				; DISABLE OPEN DRAIN DRIVE
		BANKSEL SLRCONB
		CLRF SLRCONB				; DISABLE SLEW RATE LIMITS
		
		

;*** PORT C SETUP **** PORT B RB0 IS USED AS EDGE TRIGGERED INPUT
		BANKSEL PORTC
		CLRF    PORTC				; CLEAR PORTC
		BANKSEL ANSELC
		MOVLW H'000'
		MOVWF ANSELC
		BANKSEL TRISC
		MOVLW	H'0FF'				;SET PORT C AS INPUT
		MOVWF	TRISC
		
		
; *** PORT D SETUP **** 
		BANKSEL PORTD
		CLRF PORTD
		BANKSEL TRISD
		MOVLW H'000'
		MOVWF TRISD				; SET PORTD AS OUTPUT
		BANKSEL ANSELD
		CLRF ANSELD				; SET DIGITAL I/O
		BANKSEL WPUD
		CLRF WPUD				; DISABLE WEAK PULL UPS
		BANKSEL ODCOND
		CLRF ODCOND				 ; DISABLE OPEN DRAIN
		BANKSEL SLRCOND				
		CLRF SLRCOND				 ; MAX SLEW RATE
		
; *** PORT E SETUP ****
		BANKSEL PORTE
		CLRF PORTE
		BANKSEL TRISE
		MOVLW H'008'		; SET PORT E AS OUTPUT // RE3 IS ALWAYS 1
		MOVWF TRISE
		BANKSEL ANSELE
		CLRF ANSELE		; SET PORTE AS DIGITAL
		BANKSEL WPUE
		CLRF WPUE		; DISABLE WEAK PULL UPS
		BANKSEL ODCONE
		CLRF ODCONE		; SET PUSH PULL OUTPUT
 ; SET UP I2C AS SLAVE
		BANKSEL SSP1CON1
		MOVLW H'036'	    ; SET 7 BIT SLAVE I2C
		MOVWF SSP1CON1
		BANKSEL SSP1ADD
		MOVLW H'002'	    ; SET SLAVE ADDRESS AS 0X02
		MOVWF SSP1ADD
		BANKSEL SSP1CON2
		CLRF SSP1CON2
		BSF SSP1CON2,SEN	    ; ENABLE CLOCK STRETCH
		BANKSEL SSP1CON3
		CLRF SSP1CON3
		BSF SSP1CON3,BOEN
		BSF SSP1CON3,AHEN	    ; ENABLE CLOCK STRETCH FOR ADDRESS AND DATA
		BSF SSP1CON3,DHEN
    ; CONFIGURE PORT PINS
		BANKSEL APFCON1
		CLRF APFCON1	    ; SET PORTS
		BANKSEL APFCON2
		CLRF APFCON2	    ; SET PORTS
    ; SET MIDI NOTES INTO GPRS
		BANKSEL E1MIDI
		MOVLW H'01C'    ; MIDI 28 // E1
		MOVWF E1MIDI
		MOVLW H'01D'    ; MIDI 29 // F1
		MOVWF F1MIDI
		MOVLW H'01E'    ; MIDI 30 // F#1
		MOVWF FS1MIDI
		MOVLW H'01F'    ; MIDI 31 // G1
		MOVWF G1MIDI
		MOVLW H'020'    ; MIDI 32 // G#1
		MOVWF GS1MIDI
		MOVLW H'021'    ; MIDI 33 // A1
		MOVWF A1MIDI
		MOVLW H'022'    ; MIDI 34 // A#1
		MOVWF AS1MIDI
		MOVLW H'023'    ; MIDI 35 // B1
		MOVWF B1MIDI
		MOVLW H'024'    ; MIDI 36 // C2
		MOVWF C2MIDI
		MOVLW H'025'    ; MIDI 37 // C#2
		MOVWF CS2MIDI
		MOVLW H'026'    ; MIDI 38 // D2
		MOVWF D2MIDI
		MOVLW H'027'    ; MIDI 39 // D#2
		MOVWF DS2MIDI
		MOVLW H'028'    ; MIDI 40 // E2
		MOVWF E2MIDI
		MOVLW H'029'    ; MIDI 41 // F2
		MOVWF F2MIDI
		MOVLW H'02A'    ; MIDI 42 // F#2
		MOVWF FS2MIDI
		MOVLW H'02B'    ; MIDI 43 // G2
		MOVWF G2MIDI
		MOVLW H'02C'    ; MIDI 44 // G#2
		MOVWF GS2MIDI
		MOVLW H'02D'    ; MIDI 45 // A2
		MOVWF A2MIDI
		MOVLW H'02E'    ; MIDI 46 // A#2
		MOVWF AS2MIDI
		MOVLW H'02F'    ; MIDI 47 // B2
		MOVWF B2MIDI
		MOVLW H'030'    ; MIDI 48 // C3
		MOVWF C3MIDI    
    ; SET GPRS
		CLRF BUFFER
		CLRF PITCH
		CLRF STRSEL
		RETURN
