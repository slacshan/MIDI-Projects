;***************************************************************************
;
;	    Filename: PluckSlave.ASM
;	    Date: 11/06/2024
;	    File Version: 1
;	    Author: Owen Fujii
;	    Company: Idaho State University
;	    Description: A Program for a slave I2C device that plucks the strings
;			    of a bass guitar
;**************************************************************************
	
;*************************************************************************
; 
;	    Revision History:
;   
;	    Modified as listed
;	    Started 11/06/2024
;
;*************************************************************************
    
    ; PIC16F1788 Configuration Bit Settings

; Assembly source line config statements

	#include "p16f1789.inc"
	#INCLUDE <PluckSetup.inc>
	#INCLUDE <PluckPOPout.inc>
	#INCLUDE <PluckPUSHin.inc>

; CONFIG1
; __config 0xE9A4
 __CONFIG _CONFIG1, _FOSC_INTOSC & _WDTE_OFF & _PWRTE_OFF & _MCLRE_OFF & _CP_OFF & _CPD_OFF & _BOREN_OFF & _CLKOUTEN_ON & _IESO_OFF & _FCMEN_ON
; CONFIG2
; __config 0xDFFF
 __CONFIG _CONFIG2, _WRT_OFF & _VCAPEN_OFF & _PLLEN_ON & _STVREN_ON & _BORV_LO & _LPBOR_OFF & _LVP_OFF

 
 ;*********************
 ;Define Constants
 ;*********************
 
 ;***********************************************************
 ; GENERAL PURPOSE REGISTER ALLOCATIONS
 ; RESERVED H'20' AND H'21' FOR STATUS SAVE
	BUFFER	    EQU H'022'
	VBYTE	    EQU H'023'
	SBYTE	    EQU H'024'
	TEMP	    EQU H'025'
	ALTSTORE    EQU H'026'
	ALTCLEAR    EQU H'027'

 

    ORG H'000'					
    GOTO SETUP					;RESET CONDITION GOTO SETUP
    ORG H'004'
    GOTO INTER
    
    
    
SETUP
    BANKSEL OSCCON
    MOVLW H'07B'	    ; SET 16MHZ INTERNAL OSSCILATOR
    MOVWF OSCCON
    BANKSEL OSCSTAT
    BTFSC OSCSTAT,OSTS	    ; WAIT FOR OSSCILATOR TO BE READY
    GOTO $-1
    CALL START		    ; CALL SETUP INCLUDE
    ; I2C SLAVE SETUP
    BANKSEL SSP1CON1
    MOVLW H'036'	    ; SET 7 BIT SLAVE I2C
    MOVWF SSP1CON1
    BANKSEL SSP1ADD
    MOVLW H'020'	    ; SET SLAVE ADDRESS A 0X10
    MOVWF SSP1ADD
    BANKSEL SSP1CON2
    CLRF SSP1CON2
    BSF SSP1CON2,SEN	    ; ENABLE CLOCK STRETCH
    BANKSEL SSP1CON3
    CLRF SSP1CON3
    BSF SSP1CON3,BOEN
    BSF SSP1CON3,AHEN	    ; ENABLE CLOCK STRETCH FOR ADDRESS AND DATA
    BSF SSP1CON3,DHEN
    ; SET PIN FUNCTIONS
    BANKSEL APFCON1
    CLRF APFCON1	    ; SET PORTS
    BANKSEL APFCON2
    CLRF APFCON2	    ; SET PORTS
    ; ENABLE I2C INTERRUPTS
    BANKSEL PIE1
    BSF PIE1,SSP1IE
    ; CONFIGURE GPRS
    BANKSEL PORTD
    CLRF BUFFER
    MOVLW H'055'
    MOVWF ALTSTORE	    ; SET THE FIRST BITS FOR EACH ALTERNATING
    CLRF ALTCLEAR	    ; PLUCKING SET
    ; ENABLE INTERRUPTS
    BANKSEL INTCON
    BSF INTCON,GIE	    ; ENABLE INTERRUPTS
    BSF INTCON,PEIE
    BANKSEL PORTD
    MOVLW H'04F'
    MOVWF PORTD		    ; ENABLE MUTES FOR ALL STRINGS STATUS IS ALSO SET
    GOTO MAIN

MAIN
    BANKSEL PORTD
    BTFSS BUFFER,1
    GOTO MAIN
    BSF PORTD,7		    ; SET ACTIVE FLAG
    BTFSC SBYTE,7
    GOTO PICK		    ; GOTO TO PICKING UNIT
    CLRF TEMP		    ; CLEAR TEMP REGISTER
    MOVFW TEMP		    ; MOVE H'00' INTO TEMP
    BCF STATUS,Z
    SUBWF VBYTE,0	    ; CHECK IF VELOCITY IS 0
    BTFSC STATUS,Z
    GOTO CLEAR
    BTFSS SBYTE,4
    GOTO MUTE		    ; CHECK MUTE INDICATION
    BTFSC SBYTE,0
    CALL PLUCKE		    ; CHECK FOR E STRING 
    BTFSC SBYTE,1
    CALL PLUCKA		    ; CHECK FOR A STRING
    BTFSC SBYTE,2
    CALL PLUCKD		    ; CHECK FOR D STRING
    BTFSC SBYTE,3
    CALL PLUCKG		    ; CHECK FOR G STRING
CLEAR			    ; CLEAR AT END
    CLRF BUFFER
    CLRF SBYTE
    CLRF VBYTE
    BCF PORTD,7		    ; CLEAR ACTIVE FLAG
    GOTO MAIN
    
    
MUTE
    BTFSC SBYTE,0
    BSF PORTD,0		    ; ENABLE STRING MUTE FOR E STRING
    BTFSC SBYTE,1
    BSF PORTD,1		    ; ENABLE STRING MUTE FOR A STRING
    BTFSC SBYTE,2
    BSF PORTD,2		    ; ENABLE STRING MUTE FOR D STRING
    BTFSC SBYTE,3
    BSF PORTD,3		    ; ENABLE STRING MUTE FOR G STRING
    GOTO CLEAR
    
PLUCKE
    BANKSEL PORTB
    BCF PORTD,0		; DISABLE MUTE ON STRING
    BTFSS ALTSTORE,0	; USE PLUCK UNIT 0 IF SET
    GOTO ALTE
    BSF PORTB,0		; ENABLE UNIT 0 PLUCKING UNIT
    BSF ALTSTORE,1	; SET BIT TO USE UNIT 1 NEXT ITERATION
    BCF ALTSTORE,0
    BSF ALTCLEAR,0	; SET THAT RB0 NEEDS CLEARED AFTER TIMER ELAPSES
    GOTO SKIPE
ALTE
    BTFSS ALTSTORE,1
    GOTO $+5
    BSF PORTB,1
    BSF ALTSTORE,0	; SET BIT TO USE UNIT 0 NEXT ITERATION
    BCF ALTSTORE,1	
    BSF ALTCLEAR,1	; SET THAT RB1 NEEDS TO BE CLEARED WHEN TIMER ELAPSES
SKIPE
    CALL STARTTMR
    RETURN
    
     
PLUCKA
    BANKSEL PORTB
    BCF PORTD,1		; DISABLE MUTE FOR A STRING
    BTFSS ALTSTORE,2	; USE PLUCK UNIT 2 IF SET
    GOTO ALTA
    BSF PORTB,2		; ENABLE UNIT 2 PLUCKING UNIT
    BSF ALTSTORE,3	; SET BIT TO USE UNIT 1 NEXT ITERATION
    BCF ALTSTORE,2
    BSF ALTCLEAR,2	; SET THAT RB2 NEEDS CLEARED AFTER TIMER ELAPSES
    GOTO SKIPA
ALTA
    BTFSS ALTSTORE,3
    GOTO $+5
    BSF PORTB,3
    BSF ALTSTORE,2	; SET BIT TO USE UNIT 3 NEXT ITERATION
    BCF ALTSTORE,3	
    BSF ALTCLEAR,3	; SET THAT RB3 NEEDS TO BE CLEARED WHEN TIMER ELAPSES
SKIPA
    CALL STARTTMR
    RETURN
    
PLUCKD
    BANKSEL PORTB
    BCF PORTD,2		; DISABLE MUTE FOR D STRING
    BTFSS ALTSTORE,4	; USE PLUCK UNIT 4 IF SET
    GOTO ALTD
    BSF PORTB,4		; ENABLE UNIT 4 PLUCKING UNIT
    BSF ALTSTORE,5	; SET BIT TO USE UNIT 5 NEXT ITERATION
    BCF ALTSTORE,4
    BSF ALTCLEAR,4	; SET THAT RB4 NEEDS CLEARED AFTER TIMER ELAPSES
    GOTO SKIPD
ALTD
    BTFSS ALTSTORE,5
    GOTO $+5
    BSF PORTB,5
    BSF ALTSTORE,4	; SET BIT TO USE UNIT 4 NEXT ITERATION
    BCF ALTSTORE,5	
    BSF ALTCLEAR,5	; SET THAT RB5 NEEDS TO BE CLEARED WHEN TIMER ELAPSES
SKIPD
    CALL STARTTMR
    RETURN   
    
PLUCKG
    BANKSEL PORTB
    BCF PORTD,3		; DISABLE MUTE FOR G STRING
    BTFSS ALTSTORE,6	; USE PLUCK UNIT 6 IF SET
    GOTO ALTG
    BSF PORTB,6		; ENABLE UNIT 6 PLUCKING UNIT
    BSF ALTSTORE,7	; SET BIT TO USE UNIT 7 NEXT ITERATION
    BCF ALTSTORE,6
    BSF ALTCLEAR,6	; SET THAT RB6 NEEDS CLEARED AFTER TIMER ELAPSES
    GOTO SKIPG
ALTG
    BTFSS ALTSTORE,7
    GOTO $+5
    BSF PORTB,7
    BSF ALTSTORE,6	; SET BIT TO USE UNIT 6 NEXT ITERATION
    BCF ALTSTORE,7	
    BSF ALTCLEAR,7	; SET THAT RB7 NEEDS TO BE CLEARED WHEN TIMER ELAPSES
SKIPG
    CALL STARTTMR
    RETURN
    
PICK
    GOTO MAIN
    
STARTTMR
    BANKSEL T1CON
    BTFSC T1CON,0   ; BAIL IF COUNT CURRENTLY IN PROGRESS
    RETURN	    
    BANKSEL INTCON
    CLRF INTCON	    ; DISABLE INTERRUPTS
    BANKSEL TMR1H
    MOVLW H'0D6'
    MOVWF TMR1H
    BANKSEL TMR1L
    MOVLW H'0D8'
    MOVWF TMR1L	    ; LOAD TMR REGISTERS TO PRODUCE A 25K COUNT
    BANKSEL T1CON
    MOVLW H'034'    ; 1:8 PRESCALE WITH INSTRUCTION CLK AS SOURCE 
    MOVWF T1CON
    BSF T1CON,0	    ; ENABLE TIMER 1
    BANKSEL PIE1
    BSF PIE1,TMR1IE
    BANKSEL PORTD
    BCF PIR1,TMR1IF
    BCF PORTD,7
    BSF INTCON,GIE
    BSF INTCON,PEIE
    RETURN
    
    
STOP
    BANKSEL SSP1CON1
    BCF SSP1CON1,SSPEN
    BCF PORTC,0		    ; CLEAR ACTIVE FLAG
    NOP
    NOP
    BSF SSP1CON1,SSPEN
    RETURN
    
INTER
    BANKSEL INTCON
    CLRF INTCON
    CALL PUSHIN
    BANKSEL PIR1
    BTFSC PIR1,SSP1IF	    ; CHECK MSSP INTERRUPT FLAG
    CALL RECIEVE	
    BANKSEL SSP1STAT
    BTFSC SSP1STAT,P
    CALL STOP
    BANKSEL PIR1
    BTFSC PIR1,TMR1IF
    CALL SWITCH
    CLRF PIR1
    BANKSEL INTCON
    BSF INTCON,GIE
    BSF INTCON,PEIE
    CALL POPOUT
    RETFIE
    
RECIEVE
    BANKSEL PORTD
    BSF PORTC,0		; SET ACTIVE FLAG
    BCF PIR1,SSP1IF
    BSF PORTD,7
    BANKSEL SSP1BUF 
    MOVFW SSP1BUF	; READ RECIEVED DATA
    BANKSEL PORTB
    MOVWF TEMP
    BANKSEL SSP1STAT
    BTFSS SSP1STAT,5
    GOTO ADDRETURN
    BANKSEL PORTB
    BTFSC BUFFER,0
    GOTO STRINGSEL
    BANKSEL PORTB
    MOVFW TEMP
    MOVWF VBYTE
    BSF BUFFER,0	; SET VELOCITY BYTE RECIEVE FLAG
    BSF PORTC,0		; SET ACTIVE FLAG
    BANKSEL SSP1CON1	
    BSF SSP1CON1,CKP	; RELEASE CLOCK LINE
    RETURN
    

ADDRETURN
    BANKSEL SSP1CON1	
    BSF SSP1CON1,CKP	; RELEASE CLOCK LINE
    RETURN
    

STRINGSEL
    BANKSEL PORTB
    MOVFW TEMP
    MOVWF SBYTE
    BSF BUFFER,1	; SET STRING RECIEVE FLAG
    BANKSEL SSP1CON1	
    BSF SSP1CON1,CKP	; RELEASE CLOCK LINE
    RETURN

    
SWITCH
    BANKSEL T1CON
    BCF T1CON,0		; DISABLE TIMER 1
    BANKSEL PIE1
    BCF PIE1,TMR1IE
    BANKSEL PORTB	; CLEAR THE PORTS AS NEEDED 
    BTFSC ALTCLEAR,0	; IF MULTIPLE SET AT SAME TIME THEN THERE COULD BE
    BCF PORTB,0		; ISSUES WHEN MULTIPLE ARE SET AT ONCE
    BTFSC ALTCLEAR,1
    BCF PORTB,1
    BTFSC ALTCLEAR,2
    BCF PORTB,2
    BTFSC ALTCLEAR,3
    BCF PORTB,3
    BTFSC ALTCLEAR,4
    BCF PORTB,4
    BTFSC ALTCLEAR,5
    BCF PORTB,5
    BTFSC ALTCLEAR,6
    BCF PORTB,6
    BTFSC ALTCLEAR,7
    BCF PORTB,7
    CLRF ALTCLEAR
    RETURN
    
END





